;***************************************************************************
;
;	    Filename: I2CWRITE.inc
;	    Date: 10/28/2024
;	    File Version: 1
;	    Author: Owen Fujii
;	    Company: Idaho State University
;	    Description: A Sub FOR I2c transmit of one byte and address
;
;*************************************************************************
	
;*************************************************************************
; 
;	    Revision History:
;   
;	    Modified as listed
;	    Started 10/28/2024-10/31/2024
;	    
;
;*************************************************************************
	
	ADDDRESS EQU H'030'
	I2CBYTE  EQU H'031'
	I2CBYTE2 EQU H'032'
	FLAG	 EQU H'033'

I2CWRITE_CODE CODE
 
I2CWRITE
	BANKSEL INTCON
	CLRF INTCON	    ; CLEAR INTERRUPTS
	CALL I2CIDLE	    ; WAIT FOR IDLE LINE
	BANKSEL SSP1CON2
	BSF SSP1CON2,SEN	    ; START BIT
	BTFSC SSP1CON2,SEN   ; WAIT FOR START
	GOTO $-1
	BANKSEL PORTB
	BSF PORTB,1
	MOVF ADDRESS,0	    ; MOVE ADDRESS INTO BUFFER
	BANKSEL SSP1BUF
	MOVWF SSP1BUF
	BANKSEL SSP1STAT		; WAIT FOR CLEAR 
	BTFSC SSP1STAT,BF
	GOTO $-1
	BANKSEL SSP1CON2		
	BTFSC SSP1CON2,ACKSTAT	; VERIFY ACK FROM SLAVE
	GOTO NACK		; EXIT WITH A START BIT 
	CALL I2CIDLE		; WAIT FOR IDLE LINE
	;FINISH ADDRESS BYTE REPEAT WITH DATA BYTES
	BANKSEL PORTB
	MOVF I2CBYTE,0	; SEND DATA BYTE
	BANKSEL SSP1BUF
	MOVWF SSP1BUF
	BANKSEL SSP1STAT
	BTFSC SSP1STAT,BF
	GOTO $-1
	BANKSEL SSP1CON2
	BTFSC SSP1CON2,ACKSTAT
	GOTO NACK
	CALL I2CIDLE
	; FINISH BYTE1
	BANKSEL PORTB
	BTFSS FLAG,0	    ; CHECK FOR TWO BYTE TRANSMISSION
	GOTO FINISHED
	MOVF I2CBYTE2,0	; SEND DATA BYTE2
	BANKSEL SSP1BUF
	MOVWF SSP1BUF
	BANKSEL SSP1STAT
	BTFSC SSP1STAT,BF
	GOTO $-1
	BANKSEL SSP1CON2
	BTFSC SSP1CON2,ACKSTAT
	GOTO NACK
	; FINISH BYTE2
FINISHED
	BANKSEL SSP1CON2
	BSF SSP1CON2,PEN
	BTFSC SSP1CON2,PEN
	GOTO $-1
	BANKSEL INTCON
	BSF INTCON,GIE		; REENABLE INTERRUPTS
	BSF INTCON,PEIE
	RETURN
	
	
NACK
	BANKSEL PORTB
	BCF PORTB,1
	BANKSEL SSP1CON2
	BSF SSP1CON2,PEN
	BTFSC SSP1CON2,PEN
	GOTO $-1
	BANKSEL INTCON
	BSF INTCON,GIE		; REENABLE INTERRUPTS
	BSF INTCON,PEIE
	RETURN
	
I2CIDLE
	MOVLW H'01F'
	BANKSEL SSP1CON2
	ANDWF SSP1CON2,W ; COMPARE 1F TO CHECK FOR 5 BUSY CONDITIONS
	BANKSEL STATUS
	BTFSS STATUS,Z	; WAIT UNTIL BUSY CONDITIONS CLEARED
	GOTO I2CIDLE
CHECKW
	BANKSEL SSP1STAT
	BTFSC SSP1STAT,2   ; WAIT FOR LINE TO ALLOW NEXT BYTE
	GOTO CHECKW
	RETURN
